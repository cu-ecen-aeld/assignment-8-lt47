## base_external/package/aesdchar/Config.in
```kconfig
config BR2_PACKAGE_AESDCHAR
    bool "AESD char device server module"
    help
      Builds and installs the AESD character device server kernel module.
```
